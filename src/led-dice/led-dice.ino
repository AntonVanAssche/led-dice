#define led1 2    // LED1 is connected to pin 2
#define led2 3    // LED2 is connected to pin 3
#define led3 4    // LED3 is connected to pin 4
#define led3 4    // LED3 is connected to pin 4
#define led4 5    // LED4 is connected to pin 5
#define led5 6    // LED5 is connected to pin 6
#define led6 7    // LED6 is connected to pin 7

#define button 8  // Button is connected to pin 8

int ledPin[] = {led1, led2, led3, led4, led5, led6}; // Array of LED pins
int ledPinLength = sizeof(ledPin) / sizeof(ledPin[0]); // Length of the array

int buttonState = 0; // Variable to store the button state

long seed;
boolean randomIsSeeded = false; // Variable to store if the random number generator has been seeded

void setup() {
   // Start serial port at 9600 bps.
   Serial.begin(9600);

   // Set all LED pins to output.
   for (int i = 0; i < ledPinLength; i++) {
      pinMode(ledPin[i], OUTPUT);
   }

   // Set button pin to input.
   pinMode(button, INPUT);
}

/**
  * This method wil return an integer between 1 and 6, generated by the `random()` function.
  * The random number generator is seeded with the value returned by `millis()`
  * and analog value of the pins A0, A1 and A2.
  * A0 is connected to nothing (floating).
  * A1 is connected to a LDR.
  * A2 is connected to nothing (floating) just like A0.
  * Each time the reset button on the Arduino is pressed, the seed is changed
  * and the (boolean) randomIsSeeded variable is set to `false`.
  */
int rollDice() {
   // Seed the random number generator if it hasn't been seeded yet.
   // if (!randomIsSeeded) {
      // Calculate the seed.
      seed = ((millis() + analogRead(A0) / analogRead(A1) * analogRead(A2)) * 15485863) % 2038074743;
      Serial.println(seed);

      // Seed the random number generator.
      randomSeed(seed);

   //    randomIsSeeded = true;
   // }

   // Return a random number between 1 and 6.
   return 1 + random() % 6;
}

/**
  * Basic animation to show the dice is rolling.
  * It powers all LEDs on one by one.
  * Then it powers all LEDs off one by one.
  */
void rollDiceAnimation() {
   for (int i = 0; i < ledPinLength; i++) {
      digitalWrite(ledPin[i], HIGH);
      delay(100);
   }

   for (int i = 0; i < ledPinLength; i++) {
      digitalWrite(ledPin[i], LOW);
      delay(100);
   }
}

/**
  * Turn on the LED for the given dice number (1-6).
  * @param dice: the number genereated by `rollDice()`.
  */
void powerLEDs(int dice) {
   for (int i = 0; i < dice; i++) {
      digitalWrite(ledPin[i], HIGH);
      delay(100);
   }
}

/**
  * Turn off all LEDs.
  */
void powerLEDsOff() {
   for (int i = 0; i < ledPinLength; i++) {
      digitalWrite(ledPin[i], LOW);
   }
}

void loop() {
   // Read the button state.
   buttonState = digitalRead(button);

   // If the button is pressed, roll the dice.
   if (buttonState == HIGH) {
      powerLEDsOff();
      rollDiceAnimation();
      int dice = rollDice();
      powerLEDs(dice);
   }
}

